/dts-v1/;
/plugin/;

/ {
	compatible = "brcm,bcm2835";
	
	fragment@0 {
		target = <&i2c_arm>;
		__overlay__ {
			#address-cells = <1>;
			#size-cells = <0>;
			status = "okay";
			
			lm75a: lm75a@48 {
				compatible = "sferalabs,stratopifan";
				reg = <0x48>;
				status = "okay";
			};
		};
	};
};
